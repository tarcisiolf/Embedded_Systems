## CMakeLists.txt
```
# SPDX-License-Identifier: Apache-2.0

cmake_minimum_required(VERSION 3.13.1)
include($ENV{ZEPHYR_BASE}/cmake/app/boilerplate.cmake NO_POLICY_SCOPE)
project(Facade)

set(CMAKE_EXPORT_COMPILE_COMMANDS on)
# Schedule a new version file generation after every build
add_custom_command(
    TARGET app
    POST_BUILD
    COMMAND "${CMAKE_COMMAND}"
    -DPROJECT_SOURCE_DIR=${PROJECT_SOURCE_DIR}
    -DPROJECT_BINARY_DIR=${PROJECT_BINARY_DIR}
    -P ${PROJECT_SOURCE_DIR}/build.version.cmake
    )

list(APPEND HEADERS 
    "${PROJECT_SOURCE_DIR}/include"
    "${PROJECT_SOURCE_DIR}/build/include/generated"
    )
    
list(APPEND SOURCES
    "${PROJECT_SOURCE_DIR}/src/es_led.c"
    "${PROJECT_SOURCE_DIR}/src/es_button.c"
    "${PROJECT_SOURCE_DIR}/src/main.c"
    
)
include_directories(${HEADERS})
target_sources(app PRIVATE ${SOURCES})

include("${PROJECT_SOURCE_DIR}/build.version.cmake")
```

## prj.conf
```kconfig
CONFIG_STDOUT_CONSOLE=y
CONFIG_PRINTK=y
CONFIG_LOG=y
CONFIG_GPIO=y
CONFIG_PWM=y
```

## nrf52_pca10040.overlay
```dts
&pwm1 {
	status = "ok";
	ch0-pin = <18>;
	ch0-inverted;
};

&pwm2 {
	status = "ok";
	ch0-pin = <19>;
	ch0-inverted;
};
```

## src/main.c
```c
/*
 * Copyright (c) 2016 Intel Corporation
 *
 * SPDX-License-Identifier: Apache-2.0
 */

#include <device.h>
#include <gpio.h>
#include <zephyr.h>

#include "es_button.h"
#include "es_led.h"
#include "es_version.h"

#define LED_DEVICE LED0_GPIO_CONTROLLER
#define LED_PIN0 LED0_GPIO_PIN
#define LED_PIN1 LED1_GPIO_PIN
#define LED_PIN2 LED2_GPIO_PIN
#define LED_PIN3 LED3_GPIO_PIN

#define BUTTON_DEVICE SW0_GPIO_CONTROLLER
#define BUTTON_PIN0 SW0_GPIO_PIN
#define BUTTON_PIN1 SW1_GPIO_PIN
#define BUTTON_PIN2 SW2_GPIO_PIN

es_led_t led0       = {0};
es_led_t led1       = {0};
es_led_t led2       = {0};
es_led_t led3       = {0};
es_button_t button1 = {0};
es_button_t button0 = {0};

void es_led2_expiry_function(struct k_timer *timer_id)
{
    es_led_off(&led2);
    es_led_off(&led3);
    printk("LED timout\n");
}

K_TIMER_DEFINE(my_timer, es_led2_expiry_function, NULL);

void button0_callback(struct device *gpiob, struct gpio_callback *cb, u32_t pins)
{
    printk("Button 0 pressed!\n");
    es_led_on(&led2);
    k_timer_start(&my_timer, K_MSEC(500), 0);
}

void button1_callback(struct device *gpiob, struct gpio_callback *cb, u32_t pins)
{
    printk("Button 1 pressed!\n");
    es_led_on(&led3);
    k_timer_start(&my_timer, K_MSEC(500), 0);
}


void main(void)
{
    printk("Firmware version: %d.%d-%d\n", VERSION_MAJOR, VERSION_MINOR, VERSION_BUILD);

    es_led_init(&led0, LED_DEVICE, LED_PIN0);

    es_led_init(&led1, LED_DEVICE, LED_PIN1);
    es_led_on(&led1);

    es_led_init(&led2, LED_DEVICE, LED_PIN2);
    es_led_init(&led3, LED_DEVICE, LED_PIN3);

    es_button_create(&button0, BUTTON_DEVICE, BUTTON_PIN0, button0_callback);
    es_button_create(&button1, BUTTON_DEVICE, BUTTON_PIN1, button1_callback);

    while (1) {
        es_led_toggle(&led0);
        es_led_toggle(&led1);
        k_sleep(K_SECONDS(1));
    }
}
```

## include/es_button.h
```c
#ifndef _ES_BUTTON_H_
#define _ES_BUTTON_H_

#include <device.h>
#include <gpio.h>
#include <zephyr/types.h>

typedef struct button_s es_button_t;

struct button_s {
    struct device* dev;
    struct gpio_callback gpio_cb;
    u32_t pin;
};

int es_button_create(es_button_t* button, const char* dev_name, u32_t pin,
                     gpio_callback_handler_t callback);

#endif /*_ES_BUTTON_H_*/
```

## include/es_led.h
```c
#ifndef _ES_LED_H_
#define _ES_LED_H_

#include <device.h>
#include <zephyr/types.h>

typedef struct led_s es_led_t;

struct led_s {
    struct k_timer timer;
    struct device* dev;
    u32_t pin;
    u8_t value;
};

int es_led_init(es_led_t* led, const char* dev_name, u32_t pin);
void es_led_on(es_led_t* led);
void es_led_expiry_function(struct k_timer* timer_id);
void es_led_off(es_led_t* led);
void es_led_toggle(es_led_t* led);

#endif  // _ES_LED_H_
```

## src/es_button.c
```c
#include "es_button.h"

int es_button_create(es_button_t* button, const char* dev_name, u32_t pin,
                     gpio_callback_handler_t callback)
{
    button->dev = device_get_binding(dev_name);
    button->pin = pin;
    gpio_pin_configure(button->dev, pin,
                       GPIO_DIR_IN | GPIO_PUD_PULL_UP | GPIO_INT | GPIO_INT_DEBOUNCE
                           | GPIO_INT_EDGE | GPIO_INT_ACTIVE_HIGH);
    gpio_init_callback(&button->gpio_cb, callback, BIT(pin));
    gpio_add_callback(button->dev, &button->gpio_cb);
    gpio_pin_enable_callback(button->dev, pin);
    return 0;
}
```

## src/es_led.c
```c
#include "es_led.h"

#include <gpio.h>

#define es_led_update(led) gpio_pin_write(led->dev, led->pin, led->value)
#define es_led_update_ninja(led, v)                     \
    do {                                                \
        led->value = v;                                 \
        gpio_pin_write(led->dev, led->pin, led->value); \
    } while (0)

void es_led_expiry_function(struct k_timer* timer_id)
{
    printk("Triggered!\n");
    es_led_t* led = CONTAINER_OF(timer_id, struct led_s, timer);
    es_led_toggle(led);
}

int es_led_init(es_led_t* led, const char* dev_name, u32_t pin)
{
    led->dev   = device_get_binding(dev_name);
    led->pin   = pin;
    led->value = 0;

    gpio_pin_configure(led->dev, pin, GPIO_DIR_OUT | GPIO_POL_INV);
    es_led_off(led);
    return 0;
}

void es_led_on(es_led_t* led)
{
    led->value = 1;
    es_led_update(led);
}

void es_led_off(es_led_t* led)
{
    led->value = 0;
    es_led_update(led);
}

void es_led_toggle(es_led_t* led)
{
    es_led_update_ninja(led, !led->value);
}
```
